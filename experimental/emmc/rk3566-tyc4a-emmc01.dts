// SPDX-License-Identifier: (GPL-2.0+ OR MIT)
// Internal eMMC probe using the tested eDP/USB/Wi-Fi kernel.
#include "../wifi/rk3566-tyc4a-wifi01.dts"

&sdhci {
 status = "okay";
 bus-width = <8>;
 non-removable;
 max-frequency = <52000000>;
 cap-mmc-highspeed;
 no-sd;
 no-sdio;
 pinctrl-names = "default";
 pinctrl-0 = <&emmc_bus8 &emmc_clk &emmc_cmd>;
};
