// SPDX-License-Identifier: (GPL-2.0+ OR MIT)
// Add observable boot progress to the existing experimental SD device tree.
#include "../sd/rk3566-tyc4a-sd-experimental.dts"
#include <dt-bindings/gpio/gpio.h>
#include <dt-bindings/pinctrl/rockchip.h>

/ {
	model = "TYC4A RK3566 SD boot diagnostics";
	leds {
		compatible = "gpio-leds";
		led-0 {
			// GPIO0_B7, active high, matches the original Android DTB.
			gpios = <&gpio0 RK_PB7 GPIO_ACTIVE_HIGH>;
			label = "work";
			default-state = "on";
			linux,default-trigger = "heartbeat";
			retain-state-suspended;
		};
	};
};
